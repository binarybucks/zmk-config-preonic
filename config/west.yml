## config/west.yml
```yaml
manifest:
  remotes:
    - name: zmkfirmware
      url-base: https://github.com/zmkfirmware
    - name: urob 
      url-base: https://github.com/urob
    - name: vrinek
      url-base: https://github.com/vrinek

  projects:
    - name: zmk
      remote: urob
      revision: masked-mods-pr
      import: app/west.yml
  self:
    path: config
```
